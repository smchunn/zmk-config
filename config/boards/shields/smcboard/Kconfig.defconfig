## config/boards/shields/smcboard/Kconfig.defconfig
```kconfig
if SHIELD_SMCBOARD_LEFT

config ZMK_KEYBOARD_NAME
    default "smcboard"

config ZMK_SPLIT_ROLE_CENTRAL
    default y

endif

if SHIELD_SMCBOARD_LEFT || SHIELD_SMCBOARD_RIGHT

config ZMK_SPLIT
    default y

endif
```

## config/boards/shields/smcboard/Kconfig.shield
```kconfig
config SHIELD_SMCBOARD_LEFT
    def_bool $(shields_list_contains,smcboard_left)
config SHIELD_SMCBOARD_RIGHT
    def_bool $(shields_list_contains,smcboard_right)
```

## config/west.yml
```yaml
manifest:
  remotes:
    - name: zmkfirmware
      url-base: https://github.com/zmkfirmware
    - name: smchunn
      url-base: https://github.com/smchunn

  projects:
    - name: zmk
      remote: zmkfirmware
      import: app/west.yml
      # Pinned to the last release before ZMK main moved to Zephyr 4.1 (2025-12-09),
      # which dropped the boards/arm layout + arm/rpi_pico/rp2040.dtsi that the
      # smcboard40 board and nice_nano_v2 shields depend on. Bump only after the
      # board is migrated to the Zephyr 4.1 hardware-model v2 layout.
      revision: v0.3.0

    - name: zmk-keyboards-smcboard40
      remote: smchunn
      revision: main

  self:
    path: config
```
